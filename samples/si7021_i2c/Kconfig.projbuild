## samples/si7021_i2c/Kconfig.projbuild
```kconfig
menu "TFM Configuration"

    menu "I2C configuration"
        config I2C_MASTER_SCL
            int "SCL GPIO Num"
            default 19
            help
                GPIO number for I2C Master clock line.

        config I2C_MASTER_SDA
            int "SDA GPIO Num"
            default 18
            help
                GPIO number for I2C Master data line.

        config I2C_MASTER_PORT_NUM
            int "Port Number"
            default 1
            help
                Port number for I2C Master device.

        config I2C_MASTER_FREQUENCY
            int "Master Frequency"
            default 100000
            help
                I2C Speed of Master device.
    endmenu

    menu "Sensor data configuration"
        config WINDOW_SIZE
            int "WINDOW_SIZE - Number of samples to calculate the mean"
            range 1 4
            default 3
            help
                Number of samples to calculate the mean
    endmenu

endmenu
```

## src/sensor_client/main/Kconfig.projbuild
```kconfig
menu "TFM Configuration"

    menu "Wifi Configuration"
        config WIFI_SSID
            string "WiFi SSID"
            default "myssid"
            help
                SSID (network name) to connect to.

        config WIFI_PASSWORD
            string "WiFi Password"
            default "mypassword"
            help
                WiFi password (WPA or WPA2) to use.

        config MAXIMUM_RETRY
            int "Maximum retry"
            default 5
            help
                Set the Maximum retry to avoid station reconnecting to the AP unlimited when the AP is really inexistent.
    endmenu

    menu "MQTT Configuration"
        config BROKER_URL
            string "Broker URL"
            default "mqtt://localhost:1883"
            help
                URL of the broker to connect to
    endmenu

endmenu
```

## src/sensor_server/main/Kconfig.projbuild
```kconfig
menu "TFM Configuration"

    menu "I2C configuration"
        config I2C_MASTER_SCL
            int "SCL GPIO Num"
            default 19
            help
                GPIO number for I2C Master clock line.

        config I2C_MASTER_SDA
            int "SDA GPIO Num"
            default 18
            help
                GPIO number for I2C Master data line.

        config I2C_MASTER_PORT_NUM
            int "Port Number"
            default 1
            help
                Port number for I2C Master device.

        config I2C_MASTER_FREQUENCY
            int "Master Frequency"
            default 100000
            help
                I2C Speed of Master device.
    endmenu

    menu "Sensor data configuration"
        config BUFFER_SIZE
            int "Number of measurements to store"
            range 1 10
            default 5
            help
                Number of measurements to store

        config WINDOW_SIZE
            int "Number of samples to calculate the mean"
            range 1 10
            default 3
            help
                Number of samples to calculate the mean

        config DELAY_TIME_ITEMS
            int "Time between sensor measurements in seconds"
            range 1 5
            default 2
            help
                Time between sensor measurements in seconds
    endmenu

endmenu
```
